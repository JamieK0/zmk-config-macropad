## config/boards/shields/macropad/Kconfig.defconfig
```kconfig
if SHIELD_MACROPAD

config ZMK_MACROPAD
    bool "Enable macropad features"
    default y  # Enable ZMK_MACROPAD when SHIELD_MACROPAD is active.

endif
```
